# file: Lab1.ioc
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ARM.CMSIS.5.7.0.CMSISJjDSP=Library
Mcu.Family=STM32L4
Mcu.Name=STM32L4S5VITx
Mcu.Package=LQFP100
NVIC.PriorityGroup=NVIC_PRIORITYGROUP_4
PA13\ (JTMS/SWDIO).Mode=Serial_Wire
PA13\ (JTMS/SWDIO).Signal=SYS_JTMS-SWDIO
PA14\ (JTCK/SWCLK).Mode=Serial_Wire
PA14\ (JTCK/SWCLK).Signal=SYS_JTCK-SWCLK
PB3\ (JTDO/TRACESWO).Signal=SYS_JTDO-SWO
ProjectManager.HeapSize=0x200
ProjectManager.StackSize=0x400
ProjectManager.TargetToolchain=STM32CubeIDE
RCC.ADCFreq_Value=48000000
RCC.AHBFreq_Value=120000000
RCC.APB1Freq_Value=120000000
RCC.APB1TimFreq_Value=120000000
RCC.APB2Freq_Value=120000000
RCC.APB2TimFreq_Value=120000000
RCC.CortexFreq_Value=120000000
RCC.HCLKFreq_Value=120000000
RCC.HSE_VALUE=8000000
RCC.HSI48_VALUE=48000000
RCC.HSI_VALUE=16000000
RCC.LSE_VALUE=32768
RCC.MSI_VALUE=4000000
RCC.PLLN=60
RCC.PLLSAI1N=24
RCC.SYSCLKFreq_VALUE=120000000
RCC.SYSCLKSource=RCC_SYSCLKSOURCE_PLLCLK
RCC.USBFreq_Value=48000000
RCC.VCOOutputFreq_Value=240000000
board=B-L4S5I-IOT01A

// file: Core/Src/main.c
/* USER CODE BEGIN Header */
/**
  ******************************************************************************
  * @file           : main.c
  * @brief          : Main program body
  ******************************************************************************
  * @attention
  *
  * <h2><center>&copy; Copyright (c) 2021 STMicroelectronics.
  * All rights reserved.</center></h2>
  *
  * This software component is licensed by ST under BSD 3-Clause license,
  * the "License"; You may not use this file except in compliance with the
  * License. You may obtain a copy of the License at:
  *                        opensource.org/licenses/BSD-3-Clause
  *
  ******************************************************************************
  */
/* USER CODE END Header */
#include "main.h"

/* USER CODE BEGIN Includes */
#include <math.h>
#include <time.h>

#define ARM_MATH_CM4
#include <arm_math.h>
/* USER CODE END Includes */

/* USER CODE BEGIN PTD */
#define ITM_Port32(n) (*((volatile unsigned long *) (0xE0000000+4*n)))
/* USER CODE END PTD */

void SystemClock_Config(void);
static void MX_GPIO_Init(void);
/* USER CODE BEGIN PFP */

#define TEST_ARRAY {10.4915760032, 10.1349974709, 9.53992591829, 9.60311878706, 10.4858891793, 10.1104642352, 9.51066931906, 9.75755656493, 9.82154078273, 10.2906541933, 10.4861328671, 9.57321181356, 9.70882714139, 10.4359069357, 9.70644021369, 10.2709894039, 10.0823149505, 10.2954563443, 9.57130449017, 9.66832136479, 10.4521677502, 10.4287240667, 10.1833650752, 10.0066049721, 10.3279461634, 10.4767210803, 10.3790964606, 10.1937408814, 10.0318963522, 10.4939180917, 10.2381858895, 9.59703103024, 9.62757986516, 10.1816981174, 9.65703773168, 10.3905666599, 10.0941977598, 9.93515274393, 9.71017053437, 10.0303874259, 10.0173504397, 9.69022731474, 9.73902896102, 9.52524419732, 10.3270730526, 9.54695650657, 10.3573960542, 9.88773266876, 10.1685038683, 10.1683694089, 9.88406620159, 10.3290065898, 10.2547227265, 10.4733422906, 10.0133952458, 10.4205693583, 9.71335255372, 9.89061396699, 10.1652744131, 10.2580948608, 10.3465431058, 9.98446410493, 9.79376005657, 10.202518901, 9.83867150985, 9.89532986869, 10.2885062658, 9.97748768804, 10.0403923759, 10.1538911808, 9.78303667556, 9.72420149909, 9.59117495073, 10.1716116012, 10.2015818969, 9.90650056596, 10.3251329834, 10.4550120431, 10.4925749165, 10.1548177178, 9.60547133785, 10.4644672766, 10.2326496615, 10.2279703226, 10.3535284606, 10.2437410625, 10.3851531317, 9.90784804928, 9.98208344925, 9.52778805729, 9.69323876912, 9.92987312087, 9.73938925207, 9.60543743477, 9.79600805462, 10.4950988486, 10.2814361401, 9.7985283333, 9.6287888922, 10.4491538991, 9.5799256668}

typedef struct kalman_state{
    float q; //process noise covariance
    float r; //measurement noise covariance
    float x; //estimated value
    float p; //estimation error covariance
    float k; // adaptive Kalman filter gain
}kalman_state;

/*
 * Wrapper function for testing
 */
int Kalmanfilter(float* InputArray, float* OutputArray, kalman_state* kstate, int Length);

/*
 * Assembly update function
 * Returns 0 if success
 * Returns -1 if not success (overflow, underflow, division by zero...)
 */
extern int kalmanASS(kalman_state* kstate, float);

/*
 * C update function
 * Returns 0 if success
 * Returns -1 if not success (overflow, underflow, division by zero...)
 */
int kalmanC(kalman_state* kstate, float measurement);

/*
 * Math Functions for statistical analysis
 */
float* subtraction(float* differences, float* InputArray, float* OutputArray ,int Length);
float standardDeviation(float* differences, float Length);
float correlation(float* correlationArray, float* InputArray, float* OutputArray, int Length);
float convolution(float* convolutionArray, float* InputArray, float* OutputArray, int Length);

/* USER CODE END PFP */

/* USER CODE BEGIN 0 */

int Kalmanfilter(float* InputArray, float* OutputArray, kalman_state* kstate, int Length) {

	/*
	 * Kalmanfilter:
	 * There are four parts to this function:
	 * 		1. Generating outputs with assembly + statistical calculation with C
	 * 		2. Generating outputs with C + statistical calculation with C
	 * 		3. Generating outputs with assembly + statistical calculation with CMSIS-DSP library
	 * 		4. Generating outputs with C + statistical calculation with CMSIS-DSP library
	 *
	 * The time values for each part are saved in time_spent1, time_spent2, time_spent3, and time_spent4
	 */

	//Saving initial kstate for reinitializing later
	float q = kstate->q;
	float r = kstate->r;
	float x = kstate->x;
	float p = kstate->p;
	float k = kstate->k;
	/*------------------------------------------------------------------------------------------
	 * Generating outputs with assembly + calculating with C------------------------------------
	 ------------------------------------------------------------------------------------------*/
	int result;
	ITM_Port32(31) = 1;
	// Create the output array with the assembly function
	uint32_t start = HAL_GetTick(); //Measure time
	for(int position = 0; position < Length; position++){
		result = kalmanASS(kstate, InputArray[position]);
        OutputArray[position] = kstate->x;
    }
	ITM_Port32(31) = 2;

	//NaN detection - if there was a NaN in the output, result will be -1
	if (result == -1) {
		return result;
	}

	 // Subtraction
	float differences1[Length];
	subtraction(differences1, InputArray, OutputArray, Length);

	// Standard Deviation
	float stdDev1;
	stdDev1 = standardDeviation(differences1, Length);

	// Correlation
	float corr1[Length];
	correlation(corr1, InputArray, OutputArray, Length);

	// Convolution
	float conv1[Length];
	convolution(conv1, InputArray, OutputArray, Length);

	uint32_t end = HAL_GetTick(); //Measure time
	long time_spent1 = (long)(end - start);
	//------------------------------------------------------------------------------------------

	/*------------------------------------------------------------------------------------------
	 * Generating outputs with C + calculating with C-------------------------------------------
	 -------------------------------------------------------------------------------------------*/
	// Create the output array with the assembly function
	kstate->q = q;
	kstate->r = r;
	kstate->x = x;
	kstate->p = p;
	kstate->k = k;
	start = HAL_GetTick(); //Measure time
	for(int position = 0; position < Length; position++){
		result = kalmanC(kstate, InputArray[position]);
		OutputArray[position] = kstate->x;
	}

	//NaN detection - if there was a NaN in the output, result will be -1
	if (result == -1) {
		return result;
	}

	 // Subtraction
	float differences2[Length];
	subtraction(differences2, InputArray, OutputArray, Length);

	// Standard Deviation
	float stdDev2;
	stdDev2 = standardDeviation(differences2, Length);

	// Correlation
	float corr2[Length];
	correlation(corr2, InputArray, OutputArray, Length);

	// Convolution
	float conv2[Length];
	convolution(conv2, InputArray, OutputArray, Length);

	end = HAL_GetTick(); //Measure time
	double time_spent2 = (double)(end - start);
	//------------------------------------------------------------------------------------------

	/*------------------------------------------------------------------------------------------
	 * Generating outputs with assembly + calculating with CMSIS-DSP----------------------------
	 ------------------------------------------------------------------------------------------*/
	// Create the output array with the assembly function
	kstate->q = q;
	kstate->r = r;
	kstate->x = x;
	kstate->p = p;
	kstate->k = k;
	start = HAL_GetTick(); //Measure time
	for(int position = 0; position < Length; position++){
		int result = kalmanASS(kstate, InputArray[position]);
		OutputArray[position] = kstate->x;
	}

	//NaN detection - if there was a NaN in the output, result will be -1
	if (result == -1) {
		return result;
	}

	//Subtraction
	float differences3[Length];
	arm_sub_f32(InputArray, OutputArray, differences3, Length);

	//Standard Deviation
	float stdDev3;
	arm_std_f32(differences3, Length, &stdDev3);

	//Correlation
	float corr3[(2*Length - 1)];
	arm_correlate_f32(InputArray, Length, OutputArray, Length, &corr3);

	//Convolution
	float conv3[(2*Length - 1)];
	arm_conv_f32(InputArray, Length, OutputArray, Length, &conv3);

	end = HAL_GetTick(); //Measure time
	double time_spent3 = (double)(end - start);
	//------------------------------------------------------------------------------------------

	/*------------------------------------------------------------------------------------------
	 * Generating outputs with C + calculating with CMSIS-DSP----------------------------
	 ------------------------------------------------------------------------------------------*/
	// Create the output array with the assembly function
	kstate->q = q;
	kstate->r = r;
	kstate->x = x;
	kstate->p = p;
	kstate->k = k;
	start = HAL_GetTick(); //Measure time
	for(int position = 0; position < Length; position++){
		int result = kalmanC(kstate, InputArray[position]);
		OutputArray[position] = kstate->x;
	}

	//NaN detection - if there was a NaN in the output, result will be -1
	if (result == -1) {
		return result;
	}

	//Subtraction
	float differences4[Length];
	arm_sub_f32(InputArray, OutputArray, differences4, Length);

	//Standard Deviation
	float stdDev4[Length];
	arm_std_f32(differences4, Length, &stdDev4);

	//Correlation
	float corr4[(2*Length - 1)];
	arm_correlate_f32(InputArray, Length, OutputArray, Length, &corr4);

	//Convolution
	float conv4[(2*Length - 1)];
	arm_conv_f32(InputArray, Length, OutputArray, Length, &conv4);

	end = HAL_GetTick(); //Measure time
	double time_spent4 = (double)(end - start);
	//------------------------------------------------------------------------------------------

    return result;
}

int kalmanC(kalman_state* kstate, float measurement){
	//Typical Kalman Filter update
	kstate->p = kstate->p + kstate->q;
	kstate->k = kstate->p/(kstate->p + kstate->r);
	kstate->x = kstate->x + kstate->k * (measurement - kstate->x);
	kstate->p = (1 - kstate->k) * kstate->p;

	//Checking for NaN's
	if isnan(kstate->p) {
		return -1;
	}
	else if isnan(kstate->k) {
		return -1;
	}
	else if isnan(kstate->x) {
		return -1;
	}
	else if isnan(kstate->r) {
		return -1;
	}
	else {
		return 0;
	}
}

float* subtraction(float* differences, float* InputArray, float* OutputArray ,int Length){
    for(int position = 0; position < Length; position++){
        float difference = InputArray[position] - OutputArray[position];
        differences[position] = difference;
    }
    return differences;
}

float standardDeviation(float* differences, float Length){
    float mean = 0;
    for(int position = 0; position < Length; position++){
        mean += differences[position]/Length;
    }
    float sum = 0;
    for(int position = 0; position < Length; position++){
        sum += pow((differences[position] - mean), 2);
    }
    float standardDeviation = sqrt(sum/Length);
    return standardDeviation;
}

float correlation(float* correlationArray, float* InputArray, float* OutputArray, int Length){
    float correlation = 0;
    for(int position = 0; position < Length; position++){
    	correlation += InputArray[position]*OutputArray[(Length-1) - position];
        correlationArray[position] = correlation;
    }
    return correlation;
}

float convolution(float* convolutionArray, float* InputArray, float* OutputArray, int Length){
    float convolution = 0;
    for(int position = 0; position < Length; position++){
        convolution += InputArray[position]*OutputArray[position];
        convolutionArray[position] = convolution;
    }
    return convolution;
}

/* USER CODE END 0 */

int main(void)
{

  /* MCU Configuration--------------------------------------------------------*/

  /* Reset of all peripherals, Initializes the Flash interface and the Systick. */
  HAL_Init();

  /* Configure the system clock */
  SystemClock_Config();

  /* Initialize all configured peripherals */
  MX_GPIO_Init();
  /* USER CODE BEGIN 2 */

  kalman_state  kstate = { 0.1, 0.1, 5, 0.1, 0.0 };
  float InputArray[] = TEST_ARRAY;
  int Length = (int)sizeof(InputArray)/sizeof(float);
  float OutputArray[Length];

  int result = Kalmanfilter(InputArray, OutputArray, &kstate, Length);

  /* USER CODE END 2 */

  /* Infinite loop */
  while (1)
  {

  }
}

void SystemClock_Config(void)
{
  RCC_OscInitTypeDef RCC_OscInitStruct = {0};
  RCC_ClkInitTypeDef RCC_ClkInitStruct = {0};

  /** Configure the main internal regulator output voltage
  */
  if (HAL_PWREx_ControlVoltageScaling(PWR_REGULATOR_VOLTAGE_SCALE1_BOOST) != HAL_OK)
  {
    Error_Handler();
  }
  /** Initializes the RCC Oscillators according to the specified parameters
  * in the RCC_OscInitTypeDef structure.
  */
  RCC_OscInitStruct.OscillatorType = RCC_OSCILLATORTYPE_MSI;
  RCC_OscInitStruct.MSIState = RCC_MSI_ON;
  RCC_OscInitStruct.MSICalibrationValue = 0;
  RCC_OscInitStruct.MSIClockRange = RCC_MSIRANGE_6;
  RCC_OscInitStruct.PLL.PLLState = RCC_PLL_ON;
  RCC_OscInitStruct.PLL.PLLSource = RCC_PLLSOURCE_MSI;
  RCC_OscInitStruct.PLL.PLLM = 1;
  RCC_OscInitStruct.PLL.PLLN = 60;
  RCC_OscInitStruct.PLL.PLLP = RCC_PLLP_DIV2;
  RCC_OscInitStruct.PLL.PLLQ = RCC_PLLQ_DIV2;
  RCC_OscInitStruct.PLL.PLLR = RCC_PLLR_DIV2;
  if (HAL_RCC_OscConfig(&RCC_OscInitStruct) != HAL_OK)
  {
    Error_Handler();
  }
  /** Initializes the CPU, AHB and APB buses clocks
  */
  RCC_ClkInitStruct.ClockType = RCC_CLOCKTYPE_HCLK|RCC_CLOCKTYPE_SYSCLK
                              |RCC_CLOCKTYPE_PCLK1|RCC_CLOCKTYPE_PCLK2;
  RCC_ClkInitStruct.SYSCLKSource = RCC_SYSCLKSOURCE_PLLCLK;
  RCC_ClkInitStruct.AHBCLKDivider = RCC_SYSCLK_DIV1;
  RCC_ClkInitStruct.APB1CLKDivider = RCC_HCLK_DIV1;
  RCC_ClkInitStruct.APB2CLKDivider = RCC_HCLK_DIV1;

  if (HAL_RCC_ClockConfig(&RCC_ClkInitStruct, FLASH_LATENCY_5) != HAL_OK)
  {
    Error_Handler();
  }
}

static void MX_GPIO_Init(void)
{

  /* GPIO Ports Clock Enable */
  __HAL_RCC_GPIOA_CLK_ENABLE();
  __HAL_RCC_GPIOB_CLK_ENABLE();

}

void Error_Handler(void)
{
  __disable_irq();
  while (1)
  {
  }
}

/************************ (C) COPYRIGHT STMicroelectronics *****END OF FILE****/
